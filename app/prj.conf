## CMakeLists.txt
```
#-------------------------------------------------------------------------------
# Zephyr Example Application
#
# Copyright (c) 2021 Nordic Semiconductor ASA
# SPDX-License-Identifier: Apache-2.0

cmake_minimum_required(VERSION 3.13.1)
find_package(Zephyr REQUIRED HINTS $ENV{ZEPHYR_BASE})

project(app LANGUAGES C)

target_sources(app PRIVATE 
	src/main.c
	src/demo.c
	src/ws2812/ws2812.c
	src/ws2812/drivers/ws2812_nrfx.c
	src/ble.c
	src/bat.c
	src/button.c
)

zephyr_include_directories(
	src/ws2812
	src/ws2812/drivers
	$ENV{ZEPHYR_BASE}/
)
```

## prj.conf
```kconfig
# Copyright (c) 2021 Nordic Semiconductor ASA
# SPDX-License-Identifier: Apache-2.0
#
# This file contains selected Kconfig options for the application.

CONFIG_SENSOR=y
CONFIG_BLINK=y
CONFIG_MINIMAL_LIBC=y

CONFIG_NRFX_PWM0=y
CONFIG_NRFX_GPIOTE0=y

CONFIG_NRFX_SAADC=y

CONFIG_SYSTEM_WORKQUEUE_STACK_SIZE=2048

#CONFIG_NO_OPTIMIZATIONS=y
#CONFIG_LOG=n

CONFIG_BT_CTLR_ASSERT_OVERHEAD_START=n
CONFIG_BT_CTLR_XTAL_ADVANCED=n
CONFIG_BT_CTLR_ADVANCED_FEATURES=y

CONFIG_BT=y
CONFIG_LOG=y
CONFIG_BT_SMP=y
CONFIG_BT_SIGNING=y
CONFIG_BT_PERIPHERAL=y
CONFIG_BT_DIS=y
CONFIG_BT_ATT_PREPARE_COUNT=5


# Default value is 50. I am getting some kernel OOPS, might be because
# of the crystal accuracy???
# This ain't the problem
#CONFIG_CLOCK_CONTROL_NRF_K32SRC_150PPM=y

# Trying... I doubt this is the issue but let's try
CONFIG_BOARD_ENABLE_DCDC=n

# Services from zephyr. They get automagically added to the services list
CONFIG_BT_BAS=y
CONFIG_BT_HRS=n
CONFIG_BT_IAS=n
CONFIG_BT_DIS=n

# we want a fixed MAC address. 
# see https://github.com/zephyrproject-rtos/zephyr/issues/33645
CONFIG_BT_PRIVACY=n 

# 0x07C6 = 1990
CONFIG_BT_DEVICE_APPEARANCE=1990

CONFIG_BT_DEVICE_NAME="BlaatSchaap Party Hat"
CONFIG_BT_DEVICE_NAME_DYNAMIC=y
CONFIG_BT_DEVICE_NAME_MAX=65
CONFIG_DEVICE_NAME_GATT_WRITABLE_ENCRYPT=n

#CONFIG_BT_KEYS_OVERWRITE_OLDEST=y
#CONFIG_BT_SETTINGS=y
#CONFIG_FLASH=y
#CONFIG_FLASH_MAP=y
#CONFIG_NVS=y
#CONFIG_SETTINGS=y
```

## src/main.c
```c
/*
 * Copyright (c) 2021 Nordic Semiconductor ASA
 * SPDX-License-Identifier: Apache-2.0
 */

#include <zephyr/drivers/sensor.h>
#include <zephyr/kernel.h>
#include <zephyr/logging/log.h>

#include <app/drivers/blink.h>

#include <app_version.h>

#include <stdio.h>







void ws2812_blue(void);
void ws2812_demo(void);
int ble_init(void);

extern void ble_battery_process(struct k_timer *work);
extern void adc_init();
K_TIMER_DEFINE(ble_battery_timer, ble_battery_process, NULL);

void arch_system_halt(unsigned int reason) {
  // Zephyr Crashed, reboot
  printf("Crash with reason %d\n", reason);
  volatile int i;
  // for (i = 0 ; i < 10000; i++) __NOP();
  NVIC_SystemReset();
}


void button_process(void);
K_TIMER_DEFINE(button_timer, button_process, NULL);



int main(void) {
  ws2812_blue();
  ble_init();
  adc_init();
  button_init();
  // Measure Battery Every 10 sec
  k_timer_start(&ble_battery_timer, K_SECONDS(10), K_SECONDS(10));


  k_timer_start(&button_timer, K_MSEC(50), K_MSEC(50));

  ws2812_demo();

  return 0;
}
```

## src/bat.c
```c
#include "nrfx.h"

#include "hal/nrf_saadc.h"
#include "nrfx_saadc.h"

#define ADC_CHANNEL_COUNT (1)
// nrf_saadc_value_t g_adc_values[ADC_CHANNEL_COUNT];  // array of voids???
//  is something wrong with the nrfx integration???
//  Seems the nrfx version check macro is doing something wacky

uint16_t g_adc_values[ADC_CHANNEL_COUNT];

void adc_init(void) {
  nrfx_saadc_init(6);
  nrfx_saadc_channel_t channel_configs[ADC_CHANNEL_COUNT];
  channel_configs[0] = (nrfx_saadc_channel_t)NRFX_SAADC_DEFAULT_CHANNEL_SE(
      NRF_SAADC_INPUT_AIN0, 0);
  channel_configs[0].channel_config.gain = NRF_SAADC_GAIN1_4;
  channel_configs[0].channel_config.acq_time = NRF_SAADC_ACQTIME_40US;

  nrfx_saadc_channels_config(channel_configs, ADC_CHANNEL_COUNT);
  nrfx_saadc_simple_mode_set(0b1, NRF_SAADC_RESOLUTION_12BIT,
                             NRF_SAADC_OVERSAMPLE_16X, NULL);
}

int adc_measure(void) {
  int result = -1;
  nrfx_saadc_buffer_set(g_adc_values, ADC_CHANNEL_COUNT);
  if (NRFX_SUCCESS == nrfx_saadc_mode_trigger()) {
    result = 0;
  }

  float mv = (float)(*g_adc_values) / 4096.0f * 4800.0f;
  return mv;
}
```

## src/bat.h
```c
#ifndef __BAT_H_
#define __BAT_H_

void adc_init(void);
int adc_measure(void);

#endif
```

## src/ble.c
```c
/* main.c - Application main entry point */

/*
 * Copyright (c) 2015-2016 Intel Corporation
 *
 * SPDX-License-Identifier: Apache-2.0
 */

#include <errno.h>
#include <stddef.h>
#include <string.h>
#include <zephyr/kernel.h>
#include <zephyr/sys/byteorder.h>
#include <zephyr/sys/printk.h>
#include <zephyr/types.h>

#include <zephyr/settings/settings.h>

#include <zephyr/bluetooth/bluetooth.h>
#include <zephyr/bluetooth/conn.h>
#include <zephyr/bluetooth/gatt.h>
#include <zephyr/bluetooth/hci.h>
#include <zephyr/bluetooth/services/bas.h>
#include <zephyr/bluetooth/uuid.h>
// #include <zephyr/bluetooth/services/hrs.h>
// #include <zephyr/bluetooth/services/ias.h>

#include <stdio.h>

#include "bat.h"

static bool m_rgb_notify_on;
static bool m_bat_notify_on;

static bool m_connected;
static bool m_ble_enabled;

// Note, quick and dirty for testing
void get_leds(void **leds, int *size);
int16_t get_speed(void);
void set_speed(int16_t);

// 65dbc53e-a859-4422-947c-f016c0e0af10
#define BT_UUID_CUSTOM_SERVICE_VAL                                             \
  BT_UUID_128_ENCODE(0x65dbc53e, 0x0000, 0x4422, 0x947c, 0xf016c0e0af10)

static const struct bt_uuid_128 hat_srv_uuid =
    BT_UUID_INIT_128(BT_UUID_CUSTOM_SERVICE_VAL);

static const struct bt_uuid_128 hat_chr_rgb_uuid = BT_UUID_INIT_128(
    BT_UUID_128_ENCODE(0x65dbc53e, 0x0001, 0x4422, 0x947c, 0xf016c0e0af10));

static const struct bt_uuid_128 hat_chr_spd_uuid = BT_UUID_INIT_128(
    BT_UUID_128_ENCODE(0x65dbc53e, 0x0002, 0x4422, 0x947c, 0xf016c0e0af10));

static const struct bt_uuid_128 hat_chr_dir_uuid = BT_UUID_INIT_128(
    BT_UUID_128_ENCODE(0x65dbc53e, 0x0003, 0x4422, 0x947c, 0xf016c0e0af10));

static const struct bt_uuid_128 hat_chr_bat_uuid = BT_UUID_INIT_128(
    BT_UUID_128_ENCODE(0x65dbc53e, 0x0100, 0x4422, 0x947c, 0xf016c0e0af10));
// 0x2B18
#define hat_MAX_LEN 20

static ssize_t read_rgb(struct bt_conn *conn, const struct bt_gatt_attr *attr,
                        void *buf, uint16_t len, uint16_t offset) {
  puts("read_rgb");
  void *value; // = attr->user_data;
  int size;
  get_leds(&value, &size);

  return bt_gatt_attr_read(conn, attr, buf, len, offset, value, size);
}

static ssize_t write_rgb(struct bt_conn *conn, const struct bt_gatt_attr *attr,
                         const void *buf, uint16_t len, uint16_t offset,
                         uint8_t flags) {
  puts("write_rgb");

  void *value;
  int size;
  get_leds(&value, &size);
  if ((offset + len) > size)
    return BT_GATT_ERR(BT_ATT_ERR_INVALID_OFFSET);
  memcpy(value + offset, buf, len);
  return len;
}

//--
static ssize_t read_spd(struct bt_conn *conn, const struct bt_gatt_attr *attr,
                        void *buf, uint16_t len, uint16_t offset) {
  uint16_t speed = get_speed();

  return bt_gatt_attr_read(conn, attr, buf, len, offset, &speed, sizeof(speed));
}

static ssize_t write_spd(struct bt_conn *conn, const struct bt_gatt_attr *attr,
                         const void *buf, uint16_t len, uint16_t offset,
                         uint8_t flags) {
  puts("write_spd");

  uint16_t speed = *(uint16_t *)(buf);
  set_speed(speed);
  return len;
}

static ssize_t read_dir(struct bt_conn *conn, const struct bt_gatt_attr *attr,
                        void *buf, uint16_t len, uint16_t offset) {

  extern bool get_direction();
  bool dir = get_direction();
  ;
  return bt_gatt_attr_read(conn, attr, buf, len, offset, &dir, sizeof(dir));
}

static ssize_t write_dir(struct bt_conn *conn, const struct bt_gatt_attr *attr,
                         const void *buf, uint16_t len, uint16_t offset,
                         uint8_t flags) {

  extern void set_direction(bool direction);
  set_direction(*(bool *)(buf));

  return len;
}

static ssize_t read_bat(struct bt_conn *conn, const struct bt_gatt_attr *attr,
                        void *buf, uint16_t len, uint16_t offset) {
  uint16_t voltage = adc_measure();

  return bt_gatt_attr_read(conn, attr, buf, len, offset, &voltage,
                           sizeof(voltage));
}
//--

static void rgb_ccc_cfg_changed(const struct bt_gatt_attr *attr,
                                uint16_t value) {
  printf("rgb_ccc_cfg_changed, value %04X\n", value);
  m_rgb_notify_on = (value == BT_GATT_CCC_NOTIFY) ? 1 : 0;
}

static void bat_ccc_cfg_changed(const struct bt_gatt_attr *attr,
                                uint16_t value) {
  printf("bat_ccc_cfg_changed, value %04X\n", value);
  m_bat_notify_on = (value == BT_GATT_CCC_NOTIFY) ? 1 : 0;
}

const struct bt_gatt_cpf m_spd_cpf = {
    0x06,   // uint16
    -3,     // *10⁻³
    0x2703, // second
    0x0001, // Bluetooth SIG assigned numbers
    0x0001, // ??
};

const struct bt_gatt_cpf m_bat_cpf = {
    0x06,   // uint16
    -3,     // *10⁻³
    0x2728, // volt
    0x0001, // Bluetooth SIG assigned numbers
    0x0001, // ??
};

const struct bt_gatt_cpf m_dir_cpf = {
    0x01,   // bool
    0,      // *10⁻⁰
    0x2700, // unitless
    0x0001, // Bluetooth SIG assigned numbers
    0x0001, // ??
};

/* Vendor Primary Service Declaration */
BT_GATT_SERVICE_DEFINE(
    hat_svc,

    BT_GATT_PRIMARY_SERVICE(&hat_srv_uuid.uuid),
    BT_GATT_CHARACTERISTIC(&hat_chr_rgb_uuid.uuid,
                           BT_GATT_CHRC_READ | BT_GATT_CHRC_WRITE |
                               BT_GATT_CHRC_NOTIFY,
                           BT_GATT_PERM_READ | BT_GATT_PERM_WRITE, read_rgb,
                           write_rgb, NULL),
    BT_GATT_CCC(rgb_ccc_cfg_changed, BT_GATT_PERM_READ | BT_GATT_PERM_WRITE),
    BT_GATT_CUD("RGB", BT_GATT_PERM_READ),

    BT_GATT_CHARACTERISTIC(&hat_chr_spd_uuid.uuid,
                           BT_GATT_CHRC_READ | BT_GATT_CHRC_WRITE,
                           BT_GATT_PERM_READ | BT_GATT_PERM_WRITE, read_spd,
                           write_spd, NULL),
    BT_GATT_CUD("Speed", BT_GATT_PERM_READ), BT_GATT_CPF(&m_spd_cpf),

    BT_GATT_CHARACTERISTIC(&hat_chr_dir_uuid.uuid,
                           BT_GATT_CHRC_READ | BT_GATT_CHRC_WRITE,
                           BT_GATT_PERM_READ | BT_GATT_PERM_WRITE, read_dir,
                           write_dir, NULL),
    BT_GATT_CUD("Direction", BT_GATT_PERM_READ), BT_GATT_CPF(&m_dir_cpf),

    BT_GATT_CHARACTERISTIC(&hat_chr_bat_uuid.uuid,
                           BT_GATT_CHRC_READ | BT_GATT_CHRC_NOTIFY,
                           BT_GATT_PERM_READ | BT_GATT_PERM_WRITE, read_bat,
                           NULL, NULL),
    BT_GATT_CCC(bat_ccc_cfg_changed, BT_GATT_PERM_READ | BT_GATT_PERM_WRITE),
    BT_GATT_CUD("Voltage", BT_GATT_PERM_READ), BT_GATT_CPF(&m_bat_cpf), );

static const struct bt_data ad[] = {
    BT_DATA_BYTES(BT_DATA_FLAGS, (BT_LE_AD_GENERAL | BT_LE_AD_NO_BREDR)),
    BT_DATA_BYTES(BT_DATA_UUID16_ALL, BT_UUID_16_ENCODE(BT_UUID_BAS_VAL)),
    BT_DATA_BYTES(BT_DATA_UUID128_ALL, BT_UUID_CUSTOM_SERVICE_VAL),
};

static struct bt_data sd[] = {
    BT_DATA(BT_DATA_NAME_COMPLETE, CONFIG_BT_DEVICE_NAME,
            sizeof(CONFIG_BT_DEVICE_NAME) - 1),
};

void mtu_updated(struct bt_conn *conn, uint16_t tx, uint16_t rx) {
  printk("Updated MTU: TX: %d RX: %d bytes\n", tx, rx);
}

static struct bt_gatt_cb gatt_callbacks = {.att_mtu_updated = mtu_updated};

static struct bt_conn *m_bt_conn;



void refresh_advertising_data(struct k_work *work) {
  // https://devzone.nordicsemi.com/f/nordic-q-a/90277/using-bt_le_adv_update_data/473767?focus=true
  struct bt_data new_sd[] = {
      BT_DATA(BT_DATA_NAME_COMPLETE, bt_get_name(), strlen(bt_get_name())),
  };
  *sd = *new_sd;
  int err = bt_le_adv_update_data(ad, ARRAY_SIZE(ad), sd, ARRAY_SIZE(sd));
  printf("Update advertising status %d\n", err);

  printf("Device name %s\n", bt_get_name());
}
K_WORK_DEFINE(refresh_advertising_data_work, refresh_advertising_data);
static void connected(struct bt_conn *conn, uint8_t err) {
  if (err) {
    printk("Connection failed (err 0x%02x)\n", err);
	m_connected = false;
	m_bt_conn = NULL;
  } else {
    printk("Connected\n");
	m_connected = true;
	m_bt_conn = conn;
  }
}

static void disconnected(struct bt_conn *conn, uint8_t reason) {
  printk("Disconnected (reason 0x%02x)\n", reason);
	m_connected = false;
	m_bt_conn = NULL;
  // Update the ID in the advertising data, because the user might have changed
  // it when they were connected.
  k_work_submit(&refresh_advertising_data_work);
}

BT_CONN_CB_DEFINE(conn_callbacks) = {
    .connected = connected,
    .disconnected = disconnected,
};

static void advertise(void) {
  struct bt_data new_sd[] = {
      BT_DATA(BT_DATA_NAME_COMPLETE, bt_get_name(), strlen(bt_get_name())),
  };
  *sd = *new_sd;


  int err;
  //	err = bt_le_adv_start(BT_LE_ADV_CONN_ONE_TIME, ad, ARRAY_SIZE(ad), sd,
  //ARRAY_SIZE(sd));
  err = bt_le_adv_start(BT_LE_ADV_CONN, ad, ARRAY_SIZE(ad), sd, ARRAY_SIZE(sd));

  if (err) {
    printk("Advertising failed to start (err %d)\n", err);
    return;
  }

  printk("Advertising successfully started\n");
}

static void bt_ready(void) {


  printk("Bluetooth initialised\n");

  if (IS_ENABLED(CONFIG_SETTINGS)) {
    settings_load();
  }


}

static void bas_notify(void) {
  int16_t voltage = adc_measure();
  voltage -= 3300;

  // Note: we need to determine the discharge curve, this is a placeholder.
  int battery_level = (voltage * 100) / (4200 - 3300);
  if (battery_level < 0)
    battery_level = 0;
  if (battery_level > 100)
    battery_level = 100;
  bt_bas_set_battery_level(battery_level);
}

void bat_notify(void) {
  int16_t voltage = adc_measure();
  //	int ret = bt_gatt_notify(NULL, &hat_svc.attrs[7], &voltage,
  //sizeof(voltage));

  int ret = bt_gatt_notify_uuid(NULL, &hat_chr_bat_uuid.uuid, hat_svc.attrs,
                                &voltage, sizeof(voltage));

  printf("bat not returned %X\n");
}

int ble_init(void) {
  int err;

  err = bt_enable(NULL);
  if (err) {
    printk("Bluetooth init failed (err %d)\n", err);
    return 0;
  }

  bt_ready();
  bt_gatt_cb_register(&gatt_callbacks);
  return 0;
}

/*
int ble_deinit(void) {
	bt_disable();
}
*/

void ble_enable(void) {
	advertise();
	m_ble_enabled = true;
}
void ble_disable(void){
	bt_le_adv_stop();
	if (m_bt_conn)
		bt_conn_disconnect(m_bt_conn,BT_HCI_ERR_REMOTE_USER_TERM_CONN);
	m_ble_enabled = false;
}

bool ble_is_connected(void) {
	return m_connected;
}

bool ble_is_enabled(void) {
	return m_ble_enabled;
}

void ble_battery_process(void) {
  /* Battery level simulation */
  bas_notify();
  bat_notify();
}
```

## src/cts.c
```c
/** @file
 *  @brief CTS Service sample
 */

/*
 * Copyright (c) 2016 Intel Corporation
 *
 * SPDX-License-Identifier: Apache-2.0
 */

#include <errno.h>
#include <stddef.h>
#include <string.h>
#include <zephyr/kernel.h>
#include <zephyr/sys/byteorder.h>
#include <zephyr/sys/printk.h>
#include <zephyr/types.h>

#include <zephyr/bluetooth/bluetooth.h>
#include <zephyr/bluetooth/conn.h>
#include <zephyr/bluetooth/gatt.h>
#include <zephyr/bluetooth/hci.h>
#include <zephyr/bluetooth/uuid.h>

static uint8_t ct[10];
static uint8_t ct_update;

static void ct_ccc_cfg_changed(const struct bt_gatt_attr *attr,
                               uint16_t value) {
  /* TODO: Handle value */
}

static ssize_t read_ct(struct bt_conn *conn, const struct bt_gatt_attr *attr,
                       void *buf, uint16_t len, uint16_t offset) {
  const char *value = attr->user_data;

  return bt_gatt_attr_read(conn, attr, buf, len, offset, value, sizeof(ct));
}

static ssize_t write_ct(struct bt_conn *conn, const struct bt_gatt_attr *attr,
                        const void *buf, uint16_t len, uint16_t offset,
                        uint8_t flags) {
  uint8_t *value = attr->user_data;

  if (offset + len > sizeof(ct)) {
    return BT_GATT_ERR(BT_ATT_ERR_INVALID_OFFSET);
  }

  memcpy(value + offset, buf, len);
  ct_update = 1U;

  return len;
}

/* Current Time Service Declaration */
BT_GATT_SERVICE_DEFINE(
    cts_cvs, BT_GATT_PRIMARY_SERVICE(BT_UUID_CTS),
    BT_GATT_CHARACTERISTIC(BT_UUID_CTS_CURRENT_TIME,
                           BT_GATT_CHRC_READ | BT_GATT_CHRC_NOTIFY |
                               BT_GATT_CHRC_WRITE,
                           BT_GATT_PERM_READ | BT_GATT_PERM_WRITE, read_ct,
                           write_ct, ct),
    BT_GATT_CCC(ct_ccc_cfg_changed, BT_GATT_PERM_READ | BT_GATT_PERM_WRITE), );

static void generate_current_time(uint8_t *buf) {
  uint16_t year;

  /* 'Exact Time 256' contains 'Day Date Time' which contains
   * 'Date Time' - characteristic contains fields for:
   * year, month, day, hours, minutes and seconds.
   */

  year = sys_cpu_to_le16(2015);
  memcpy(buf, &year, 2); /* year */
  buf[2] = 5U;           /* months starting from 1 */
  buf[3] = 30U;          /* day */
  buf[4] = 12U;          /* hours */
  buf[5] = 45U;          /* minutes */
  buf[6] = 30U;          /* seconds */

  /* 'Day of Week' part of 'Day Date Time' */
  buf[7] = 1U; /* day of week starting from 1 */

  /* 'Fractions 256 part of 'Exact Time 256' */
  buf[8] = 0U;

  /* Adjust reason */
  buf[9] = 0U; /* No update, change, etc */
}

void cts_init(void) {
  /* Simulate current time for Current Time Service */
  generate_current_time(ct);
}

void cts_notify(
    void) { /* Current Time Service updates only when time is changed */
  if (!ct_update) {
    return;
  }

  ct_update = 0U;
  bt_gatt_notify(NULL, &cts_cvs.attrs[1], &ct, sizeof(ct));
}
```

## src/demo.c
```c
/*

 File: 		demo.c
 Author:	André van Schoubroeck
 License:	MIT


 MIT License

 Copyright (c) 2017, 2018, 2019, 2020 André van Schoubroeck

 Permission is hereby granted, free of charge, to any person obtaining a copy
 of this software and associated documentation files (the "Software"), to deal
 in the Software without restriction, including without limitation the rights
 to use, copy, modify, merge, publish, distribute, sublicense, and/or sell
 copies of the Software, and to permit persons to whom the Software is
 furnished to do so, subject to the following conditions:
 The above copyright notice and this permission notice shall be included in all
 copies or substantial portions of the Software.

 THE SOFTWARE IS PROVIDED "AS IS", WITHOUT WARRANTY OF ANY KIND, EXPRESS OR
 IMPLIED, INCLUDING BUT NOT LIMITED TO THE WARRANTIES OF MERCHANTABILITY,
 FITNESS FOR A PARTICULAR PURPOSE AND NONINFRINGEMENT. IN NO EVENT SHALL THE
 AUTHORS OR COPYRIGHT HOLDERS BE LIABLE FOR ANY CLAIM, DAMAGES OR OTHER
 LIABILITY, WHETHER IN AN ACTION OF CONTRACT, TORT OR OTHERWISE, ARISING FROM,
 OUT OF OR IN CONNECTION WITH THE SOFTWARE OR THE USE OR OTHER DEALINGS IN THE
 SOFTWARE.

 */

/*
 * WS2812 DMA library demo
 */

#include "ws2812.h"
#include <stdint.h>
#include "ble.h"

#include <zephyr/kernel.h>

#include <stdio.h>

static volatile uint16_t m_speed = 100;
static volatile bool m_direction = true;

uint16_t get_speed() { return m_speed; }

void set_speed(uint16_t speed) { m_speed = speed; }

bool get_direction() { return m_direction; }

void set_direction(bool direction) { m_direction = direction; }

void delay_ms(uint32_t milliseconds) { k_sleep(K_MSEC(milliseconds)); }

#pragma pack(push, 1)
typedef struct {
  uint8_t g;
  uint8_t r;
  uint8_t b;
} rgb_t;
#pragma pack(pop)

#define RED                                                                    \
  (rgb_t) { 0, 32, 0 }
#define ORANGE                                                                 \
  (rgb_t) { 16, 32, 0 }
#define YELLOW                                                                 \
  (rgb_t) { 32, 32, 0 }
#define GREEN                                                                  \
  (rgb_t) { 32, 0, 0 }
#define CYAN                                                                   \
  (rgb_t) { 32, 0, 32 }
#define BLUE                                                                   \
  (rgb_t) { 0, 0, 32 }
#define PURPLE                                                                 \
  (rgb_t) { 0, 32, 32 }
#define WHITE                                                                  \
  (rgb_t) { 16, 16, 16 }

#define LED_COUNT (19)

volatile static rgb_t m_colours[LED_COUNT] = {
    {0x00, 0x00, 0x00}, {0x19, 0x00, 0x00}, {0x19, 0x08, 0x00},
    {0x19, 0x11, 0x00}, {0x19, 0x19, 0x00}, {0x10, 0x19, 0x00},
    {0x08, 0x19, 0x00}, {0x00, 0x19, 0x00}, {0x00, 0x19, 0x08},
    {0x00, 0x19, 0x11}, {0x00, 0x19, 0x19}, {0x00, 0x10, 0x19},
    {0x00, 0x08, 0x19}, {0x00, 0x00, 0x19}, {0x08, 0x00, 0x19},
    {0x11, 0x00, 0x19}, {0x19, 0x00, 0x19}, {0x19, 0x00, 0x10},
    {0x19, 0x00, 0x08},
};

void get_leds(void **leds, int *size) {
  *leds = (void *)(m_colours + 1);
  *size = (LED_COUNT * sizeof(rgb_t)) - sizeof(rgb_t);
}

void ws2812_blue() {
  rgb_t blue[LED_COUNT] = {
      BLUE, BLUE, BLUE, BLUE, BLUE, BLUE, BLUE, BLUE, BLUE,
      BLUE, BLUE, BLUE, BLUE, BLUE, BLUE, BLUE, BLUE, BLUE,
  };
  ws2812_fill_buffer_decompress(0, sizeof(blue), blue);
  ws2812_apply(sizeof(blue));
}

static volatile bool m_button_pressed;
void button_pressed(void) {
	m_button_pressed = true;
}

#include <zephyr/bluetooth/bluetooth.h>
void ws2812_demo() {
  rgb_t temp, status;
  puts("Starting Demo");

  while (1) {
	if (m_button_pressed) {
		m_button_pressed = false;

		if (ble_is_enabled()) {
			puts("Disable BLE");
			ble_disable();
		} else {
			puts("Enable BLE");
			ble_enable();
		}
	}



    int key;
    key = irq_lock();
    rgb_t copy_of_colours[LED_COUNT];
    memcpy(copy_of_colours, m_colours, sizeof(m_colours));



	if (ble_is_enabled()) {
		if (ble_is_connected()) {
			copy_of_colours[0] = BLUE;
		} else {
			copy_of_colours[0] = GREEN;
		}
	} else {
		copy_of_colours[0] = RED;
	}



    irq_unlock(key);

    ws2812_fill_buffer_decompress(0, sizeof(copy_of_colours), copy_of_colours);
    ws2812_apply(sizeof(copy_of_colours));

    if (m_speed) {

      if (m_direction) {
        temp = copy_of_colours[1];
        for (int i = 1; i < (LED_COUNT - 1); i++) {
          copy_of_colours[i] = copy_of_colours[i + 1];
        }
        copy_of_colours[(LED_COUNT - 1)] = temp;
      } else {

        temp = copy_of_colours[LED_COUNT - 1];
        for (int i = LED_COUNT - 1; i > (1); i--) {
          copy_of_colours[i] = copy_of_colours[i - 1];
        }
        copy_of_colours[1] = temp;
      }

 

      key = irq_lock();
      memcpy((void *)m_colours, copy_of_colours, sizeof(m_colours));
      irq_unlock(key);

      delay_ms(m_speed);
    } else {
      delay_ms(250);
    }
  }
}
```
